## dts/bindings/gpio/element14,minode-connectors.yaml
```yaml
# Copyright (c) 2018, Linaro Limited
# SPDX-License-Identifier: Apache-2.0

title: Element14 minode connector parent

description: GPIO connectors parent node

compatible: "element14,minode-connectors"

child-binding:
    title: GPIO connector node
    description: GPIO connector child node
    properties:
       gpios:
          type: phandle-array
          required: true
       label:
          required: true
          type: string
          description: Human readable string describing the device (used by Zephyr for API name)
```

## lib/minode/Kconfig
```kconfig
#
# Copyright (c) 2019 Embest Tech Co., Ltd
#
# SPDX-License-Identifier: Apache-2.0
#

config ELEMENT14_MINODE_LIB
	bool "element14 mi:node starter kit library"
	depends on GPIO
	# depends on HEAP_MEM_POOL_SIZE != 0
	help
	  This enables element14 mi:node starter kit library support.

if ELEMENT14_MINODE_LIB

config ELEMENT14_MINODE_LIB_SWITCH
	bool "Switch module"
	help
	  This enables switch module of element14 mi:node starter kit support.

config ELEMENT14_MINODE_LIB_LIGHT_SENSOR
	bool "Light sensor module"
	help
	  This enables light sensor module of element14 mi:node starter kit support.

if ELEMENT14_MINODE_LIB_LIGHT_SENSOR

config ELEMENT14_MINODE_LIB_LIGHT_SAMPLINGS_COUNT
	int "Number of ADC samplings each light level get"
	range 1 8
	default 3
	help
	  Number of ADC samplings when try to get light level. And an Average
		will be the final value.

endif

config ELEMENT14_MINODE_LIB_ROTARY
	bool "Rotary module"
	help
	  This enables rotary module of element14 mi:node starter kit support.

if ELEMENT14_MINODE_LIB_ROTARY

config ELEMENT14_MINODE_LIB_ROTARY_SAMPLINGS_PERIOD_MS
	int "The period(in ms) of rotary level get"
	range 100 10000
	default 600
	help
	  It will read the rotary level every this period time. If the level changed, it will emit
		an event.

endif

config ELEMENT14_MINODE_LIB_SOUND_SENSOR
	bool "Sound sensor module"
	help
	  This enables sound sensor module of element14 mi:node starter kit support.

if ELEMENT14_MINODE_LIB_SOUND_SENSOR

config ELEMENT14_MINODE_LIB_SOUND_SENSOR_SAMPLINGS_PERIOD_MS
	int "The period(in ms) of sound get"
	range 1 10000
	default 15
	help
	  It will read the sound level every this period time to determine if there
		any noise. If any noise is detected, it will emit an event.

config ELEMENT14_MINODE_LIB_SOUND_SENSOR_SAMPLINGS_COUNT
	int "Number of ADC samplings each sound get"
	range 1 10
	default 3
	help
	  Number of ADC samplings when try to get sound level. And an Average
		will be the final value.

config ELEMENT14_MINODE_LIB_SOUND_SENSOR_NOISE_HIGHEST_FREQ_HZ
	int "The noise highest frequency to detect"
	range 20 20000
	default 10000
	help
		Usually people can hear the voice's frequency from 20Hz to 20KHz. A noise's
		frequency is usually lower than 5Khz.

config ELEMENT14_MINODE_LIB_SOUND_SENSOR_NOISE_LOWEST_AMPLITUDE_ADC_VAL
	int "The intensity of the noice"
	range 0 512
	default 80
	help
		What intensity of the voice can be considered as noise.
endif

endif
```
